// Copyright (c) 2022 The ZMK Contributors
// SPDX-License-Identifier: MIT

#undef ZMK_MOUSE_DEFAULT_MOVE_VAL
#undef ZMK_MOUSE_DEFAULT_SCRL_VAL
#define ZMK_POINTING_DEFAULT_MOVE_VAL 1200
#define ZMK_POINTING_DEFAULT_SCRL_VAL 15

#include <behaviors.dtsi>
#include <dt-bindings/zmk/bt.h>
#include <dt-bindings/zmk/keys.h>
#include <dt-bindings/zmk/pointing.h>

// Layers
#define LAYER_ABC 0
#define LAYER_SYM 1
#define LAYER_NAV 2
#define LAYER_FUN 3
#define LAYER_RAT 4

#define KEYS_L \
     0  1  2  3  4 \
    10 11 12 13 14 \
    20 21 22 23 24 \
             30 31

#define KEYS_R \
     5  6  7  8  9 \
    15 16 17 18 19 \
    25 26 27 28 29 \
    32 33

#define LDQT  RA(LBKT)
#define RDQT  RS(RA(LBKT))
#define LSQT  RA(RBKT)
#define RSQT  RS(RA(RBKT))
#define NDASH RA(MINUS)
#define MDASH RS(RA(MINUS))

// Home row mods macro
#define HRML(k1,k2,k3,k4) &hrml LSHFT k1 &hrml LALT k2 &hrml LCTRL k3 &hrml LGUI k4
#define HRMR(k1,k2,k3,k4) &hrmr RGUI k1 &hrmr RCTRL k2 &hrmr RALT k3 &hrmr RSHFT k4

// Make mod-morph macro
#define MAKE_MM(NAME, MAIN, SHIFTED) \
    NAME: NAME { \
        compatible = "zmk,behavior-mod-morph"; \
        #binding-cells = <0>; \
        bindings = <MAIN>, <SHIFTED>; \
        mods = <(MOD_LSFT|MOD_RSFT)>; \
    };

// Make hold-tap with mod-morph macro
#define MAKE_HT(NAME, TAP, KEYS) \
    NAME: NAME { \
        compatible = "zmk,behavior-hold-tap"; \
        #binding-cells = <2>; \
        flavor = "balanced"; \
        require-prior-idle-ms = <150>; \
        tapping-term-ms = <280>; \
        quick-tap-ms = <175>; \
        bindings = <&kp>, <TAP>; \
        hold-trigger-key-positions = <KEYS>; \
        hold-trigger-on-release; \
    };

// Home row mod key with mod-morph behavior
#define HRM_MM(MM, MOD) MM MOD 0

&mmv {
    acceleration-exponent = <1>;
    time-to-max-speed-ms = <550>;
    delay-ms = <0>;
};

&msc {
    acceleration-exponent = <0>;
    time-to-max-speed-ms = <0>;
    delay-ms = <0>;
};

&sk {
    release-after-ms = <1500>;
    quick-release;
};

/ {
    behaviors {
        // Tap dance: screenshot
        // Tap: Cmd+Ctrl+Shift+4 (screenshot to clipboard)
        // Double-tap: Cmd+Shift+5 (screenshot options)
        screenshot: td_screenshot {
            compatible = "zmk,behavior-tap-dance";
            #binding-cells = <0>;
            tapping-term-ms = <200>;
            bindings = <&kp LS(LC(LG(N4)))>, <&kp LS(LG(N5))>;
        };

        // Layer tap
        lt: layer_tap {
            compatible = "zmk,behavior-hold-tap";
            #binding-cells = <2>;
            flavor = "hold-preferred";
            require-prior-idle-ms = <150>;
            tapping-term-ms = <240>;
            quick-tap-ms = <175>;
            bindings = <&mo>, <&kp>;
        };

        // Home row mods
        MAKE_HT(hrml, &kp, KEYS_R)
        MAKE_HT(hrmr, &kp, KEYS_L)

        // Morph mods: symbols
        // abc
        MAKE_MM(smm_comma, &kp COMMA, &kp QMARK)
        MAKE_MM(smm_dot  , &kp DOT  , &kp EXCL )
        MAKE_MM(smm_rsqt , &kp RSQT , &kp NDASH)
        // num left
        MAKE_MM(smm2_0_, &kp MINUS, &kp UNDER) MAKE_HT(smm2_0, &smm2_0_, KEYS_R)
        MAKE_MM(smm2_1_, &kp PLUS , &kp PLUS ) MAKE_HT(smm2_1, &smm2_1_, KEYS_R)
        MAKE_MM(smm2_2_, &kp EQUAL, &kp PRCNT) MAKE_HT(smm2_2, &smm2_2_, KEYS_R)
        MAKE_MM(smm2_3_, &kp DQT  , &kp SQT  ) MAKE_HT(smm2_3, &smm2_3_, KEYS_R)
        MAKE_MM(smm2_4 , &kp COLON, &kp DOT  )
        MAKE_MM(smm3_0 , &kp STAR , &kp CARET)
        MAKE_MM(smm3_1 , &kp DLLR , &kp HASH )
        MAKE_MM(smm3_2 , &kp AMPS , &kp PIPE )
        MAKE_MM(smm3_3 , &kp EXCL , &kp QMARK)
        MAKE_MM(smm3_4 , &kp GRAVE, &kp TILDE)
        // num right
        MAKE_MM(smm2_5 , &kp SEMI , &kp COMMA)
        MAKE_MM(smm2_6_, &kp LPAR , &kp LPAR ) MAKE_HT(smm2_6, &smm2_6_, KEYS_L)
        MAKE_MM(smm2_7_, &kp RPAR , &kp AT   ) MAKE_HT(smm2_7, &smm2_7_, KEYS_L)
        MAKE_MM(smm2_8_, &kp LT   , &kp LT   ) MAKE_HT(smm2_8, &smm2_8_, KEYS_L)
        MAKE_MM(smm2_9_, &kp GT   , &kp GT   ) MAKE_HT(smm2_9, &smm2_9_, KEYS_L)
        MAKE_MM(smm3_5 , &kp FSLH , &kp BSLH )
        MAKE_MM(smm3_6 , &kp LBRC , &kp LDQT )
        MAKE_MM(smm3_7 , &kp RBRC , &kp RDQT )
        MAKE_MM(smm3_8 , &kp LBKT , &kp LSQT )
        MAKE_MM(smm3_9 , &kp RBKT , &kp RSQT )
    };

    macros {
        // Sleep (macOS): Ctrl+Cmd+Q, wait 1s, Escape
        // “cheese” is a Googler reference, if you know you know.
        no_cheese: macro_no_cheese {
            compatible = "zmk,behavior-macro";
            #binding-cells = <0>;
            wait-ms = <1000>;
            bindings
                = <&kp LC(LG(Q))>
                , <&kp ESC>
                ;
        };
    };

    conditional_layers {
        compatible = "zmk,conditional-layers";
        tri_layer {
            if-layers = <LAYER_SYM LAYER_NAV>;
            then-layer = <LAYER_RAT>;
        };
    };

    keymap {
        compatible = "zmk,keymap";

        abc_layer { // LAYER_ABC
            display-name = "abc";
            bindings = <
                // Row 1
                &kp Q &kp W &kp F &kp P &kp B
                &kp J &kp L &kp U &kp Y &kp MINUS
                // Row 2
                HRML(A, R, S, T) &kp G
                &kp M HRMR(N, E, I, O)
                // Row 3
                &kp Z &kp X &kp C &kp D &kp V
                &kp K &kp H &smm_comma &smm_dot &smm_rsqt
                // Row 4
                &sk LSHFT &lt LAYER_SYM SPACE
                &lt LAYER_NAV BSPC &sk RCTRL
            >;
        };

        sym_layer { // LAYER_SYM
            display-name = "sym";
            bindings = <
                // Row 1
                &kp N1 &kp N2 &kp N3 &kp N4 &kp N5
                &kp N6 &kp N7 &kp N8 &kp N9 &kp N0
                // Row 2
                HRM_MM(&smm2_0, LSHFT) HRM_MM(&smm2_1, LALT)
                HRM_MM(&smm2_2, LCTRL) HRM_MM(&smm2_3, LGUI)
                &smm2_4 &smm2_5
                HRM_MM(&smm2_6, RGUI) HRM_MM(&smm2_7, RCTRL)
                HRM_MM(&smm2_8, RALT) HRM_MM(&smm2_9, RSHFT)
                // Row 3
                &smm3_0 &smm3_1 &smm3_2 &smm3_3 &smm3_4
                &smm3_5 &smm3_6 &smm3_7 &smm3_8 &smm3_9
                // Row 4
                &trans &trans
                &trans &trans
            >;
        };

        nav_layer { // LAYER_NAV
            display-name = "nav";
            bindings = <
                // Row 1
                &none &none &none &none &none
                &none &kp PG_DN &kp PG_UP &none &none
                // Row 2
                &kp LSHFT &kp LALT &kp LCTRL &kp LGUI &none
                &kp LEFT &kp DOWN &kp UP &kp RIGHT &none
                // Row 3
                &kp LG(Z) &kp LG(X) &kp LG(C) &kp LG(V) &kp RG(RS(RA(V)))
                &none &kp END &kp HOME &none &none
                // Row 4
                &trans &trans
                &trans &trans
            >;
        };

        fun_layer { // LAYER_FUN
            display-name = "fun";
            bindings = <
                // Row 1
                &kp F1 &kp F2 &kp F3 &kp F4 &kp F5
                &kp F6 &kp F7 &kp F8 &kp F9 &kp F10
                // Row 2
                HRML(F11, C_PREV, C_PP, C_NEXT) &none
                &none HRMR(C_VOL_DN, C_MUTE, C_VOL_UP, F12)
                // Row 3
                &none &none &none &none &none
                &none &none &none &none &none
                // Row 4
                &trans &trans
                &trans &trans
            >;
        };

        rat_layer { // LAYER_RAT
            display-name = "rat";
            bindings = <
                // Row 1
                &none &none &msc SCRL_DOWN &none &none
                &none &none &mmv MOVE_UP &none &none
                // Row 2
                &none &msc SCRL_RIGHT &msc SCRL_UP &msc SCRL_LEFT &none
                &none &mmv MOVE_LEFT &mmv MOVE_DOWN &mmv MOVE_RIGHT &none
                // Row 3
                &none &mkp RCLK &mkp MCLK &mkp LCLK &none
                &kp LGUI &kp LCTRL &kp LALT &kp LSHFT &none
                // Row 4
                &trans &trans
                &trans &trans
            >;
        };
    };

    combos {
        compatible = "zmk,combos";

        // Function layer
        combo_fun_layer {
            timeout-ms = <50>;
            key-positions = <30 33>;
            bindings = <&mo LAYER_FUN>;
            layers = <LAYER_ABC>;
        };

        // Bootloader
        combo_bootloader_left {
            timeout-ms = <50>;
            key-positions = <0 1 2 3>;
            bindings = <&bootloader>;
            layers = <LAYER_FUN>;
        };
        combo_bootloader_right {
            timeout-ms = <50>;
            key-positions = <6 7 8 9>;
            bindings = <&bootloader>;
            layers = <LAYER_FUN>;
        };

        // Sleep (no_cheese)
        combo_no_cheese {
            timeout-ms = <50>;
            key-positions = <0 1 2 3>;
            bindings = <&no_cheese>;
            layers = <LAYER_ABC>;
        };

        // Screenshot
        combo_screenshot {
            timeout-ms = <50>;
            key-positions = <6 7 8 9>;
            bindings = <&screenshot>;
            layers = <LAYER_ABC>;
        };

        // Spotlight
        combo_spotlight {
            timeout-ms = <50>;
            key-positions = <20 21 22 23>;
            bindings = <&kp LG(SPACE)>;
            layers = <LAYER_ABC>;
        };

        // Mute
        combo_mute {
            timeout-ms = <50>;
            key-positions = <26 27 28 29>;
            bindings = <&kp C_MUTE>;
            layers = <LAYER_ABC>;
        };

        // Esc
        combo_esc {
            timeout-ms = <20>;
            key-positions = <1 2>;
            bindings = <&kp ESC>;
            layers = <LAYER_ABC LAYER_SYM>;
        };

        // Del
        combo_del {
            timeout-ms = <20>;
            key-positions = <7 8>;
            bindings = <&kp DEL>;
            layers = <LAYER_ABC LAYER_SYM>;
        };

        // Tab
        combo_tab {
            timeout-ms = <20>;
            key-positions = <11 12>;
            bindings = <&kp TAB>;
            layers = <LAYER_ABC LAYER_SYM>;
        };

        // Backspace
        combo_bspc {
            timeout-ms = <20>;
            key-positions = <17 18>;
            bindings = <&kp BSPC>;
            layers = <LAYER_ABC LAYER_SYM>;
        };

        // Enter
        combo_enter {
            timeout-ms = <20>;
            key-positions = <27 28>;
            bindings = <&kp ENTER>;
            layers = <LAYER_ABC LAYER_SYM>;
        };

        // Space
        combo_space_left {
            timeout-ms = <30>;
            key-positions = <21 22 23>;
            bindings = <&kp SPACE>;
            layers = <LAYER_ABC LAYER_SYM>;
        };
        combo_space_right {
            timeout-ms = <30>;
            key-positions = <26 27 28>;
            bindings = <&kp SPACE>;
            layers = <LAYER_ABC LAYER_SYM>;
        };

        // Caps word
        combo_cap {
            timeout-ms = <20>;
            key-positions = <21 22>;
            bindings = <&caps_word>;
            layers = <LAYER_ABC>;
        };
    };
};
