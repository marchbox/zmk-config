// Copyright (c) 2022 The ZMK Contributors
// SPDX-License-Identifier: MIT

#undef ZMK_MOUSE_DEFAULT_MOVE_VAL
#undef ZMK_MOUSE_DEFAULT_SCRL_VAL
#define ZMK_POINTING_DEFAULT_MOVE_VAL 1200
#define ZMK_POINTING_DEFAULT_SCRL_VAL 15

#include <behaviors.dtsi>
#include <dt-bindings/zmk/bt.h>
#include <dt-bindings/zmk/keys.h>
#include <dt-bindings/zmk/pointing.h>

// Layers
#define LAYER_ABC 0
#define LAYER_SYM 1
#define LAYER_NAV 2
#define LAYER_FUN 3
#define LAYER_RAT 4

#define KEYS_L \
     0  1  2  3  4 \
    10 11 12 13 14 \
    20 21 22 23 24 \
             30 31

#define KEYS_R \
     5  6  7  8  9 \
    15 16 17 18 19 \
    25 26 27 28 29 \
    32 33

#define LDQT  RA(LBKT)
#define RDQT  RS(RA(LBKT))
#define LSQT  RA(RBKT)
#define RSQT  RS(RA(RBKT))
#define NDASH RA(MINUS)
#define MDASH RS(RA(MINUS))

// Home row mods macro
#define HRML(k1,k2,k3,k4) &hrml LSHFT k1 &hrml LALT k2 &hrml LCTRL k3 &hrml LGUI k4
#define HRMR(k1,k2,k3,k4) &hrmr RGUI k1 &hrmr RCTRL k2 &hrmr RALT k3 &hrmr RSHFT k4
#define SHRML(k1,k2,k3,k4) &shrml LSHFT k1 &shrml LALT k2 &shrml LCTRL k3 &shrml LGUI k4
#define SHRMR(k1,k2,k3,k4) &shrmr RGUI k1 &shrmr RCTRL k2 &shrmr RALT k3 &shrmr RSHFT k4

// Make home row hold-tap macro
#define MAKE_HT(NAME, TAP, KEYS, TERM) \
    NAME: NAME { \
        compatible = "zmk,behavior-hold-tap"; \
        #binding-cells = <2>; \
        flavor = "balanced"; \
        require-prior-idle-ms = <150>; \
        tapping-term-ms = <TERM>; \
        retro-tap; \
        bindings = <&kp>, <TAP>; \
        hold-trigger-key-positions = <KEYS>; \
        hold-trigger-on-release; \
    };

#define MAKE_COMBO(NAME, KEYS, BINDING, LAYERS) \
    NAME { \
        timeout-ms = <50>; \
        slow-release; \
        key-positions = <KEYS>; \
        bindings = <BINDING>; \
        layers = <LAYERS>; \
    };

&mmv {
    acceleration-exponent = <1>;
    time-to-max-speed-ms = <550>;
    delay-ms = <0>;
};

&msc {
    acceleration-exponent = <0>;
    time-to-max-speed-ms = <0>;
    delay-ms = <0>;
};

&sk {
    release-after-ms = <5000>;
    quick-release;
};

/ {
    behaviors {
        // Custom Shift overrides apply only on abc; other layers use normal Shift.
        as: auto_shift {
            compatible = "zmk,behavior-auto-shift";
            #binding-cells = <1>;
            tapping-term-ms = <175>;
            overrides-layer = <LAYER_ABC>;
            overrides = <
                COMMA QMARK
                DOT   EXCL
                RSQT  NDASH
                DQT   SQT
                PRCNT AT
                COLON DOT
                STAR  CARET
                EXCL  QMARK
                SEMI  COMMA
                FSLH  BSLH
                LPAR  RPAR
                LBRC  RBRC
                LBKT  RBKT
                LT    GT
                LDQT  RDQT
                LSQT  RSQT
            >;
        };

        repeat: resolved_repeat {
            compatible = "zmk,behavior-resolved-repeat";
            #binding-cells = <0>;
        };

        alt_repeat: alternate_repeat {
            compatible = "zmk,behavior-resolved-repeat";
            #binding-cells = <0>;
            alternate;
            alternates = <
                LEFT  RIGHT
                RIGHT LEFT
                UP    DOWN
                DOWN  UP
                LS(J) LS(K)
                LS(K) LS(J)
                LG(C) LG(LS(LA(V)))
                LG(X) LG(LS(LA(V)))
            >;
        };

        // Tap dance: screenshot
        // Tap: Cmd+Ctrl+Shift+4 (screenshot to clipboard)
        // Double-tap: Cmd+Shift+5 (screenshot options)
        screenshot: td_screenshot {
            compatible = "zmk,behavior-tap-dance";
            #binding-cells = <0>;
            tapping-term-ms = <230>;
            bindings = <&kp LS(LC(LG(N4)))>, <&kp LS(LG(N5))>;
        };

        // Layer tap
        lt: layer_tap {
            compatible = "zmk,behavior-hold-tap";
            #binding-cells = <2>;
            flavor = "hold-preferred";
            require-prior-idle-ms = <150>;
            tapping-term-ms = <240>;
            quick-tap-ms = <175>;
            bindings = <&mo>, <&kp>;
        };

        // Home row mods
        MAKE_HT(shrml, &as, KEYS_R, 500)
        MAKE_HT(shrmr, &as, KEYS_L, 500)
        MAKE_HT(hrml, &kp, KEYS_R, 175)
        MAKE_HT(hrmr, &kp, KEYS_L, 175)
    };

    macros {
        // Sleep (macOS): Ctrl+Cmd+Q, wait 1s, Escape
        // “cheese” is a Googler reference, if you know you know.
        no_cheese: macro_no_cheese {
            compatible = "zmk,behavior-macro";
            #binding-cells = <0>;
            wait-ms = <1000>;
            bindings
                = <&kp LC(LG(Q))>
                , <&kp ESC>
                ;
        };
    };

    conditional_layers {
        compatible = "zmk,conditional-layers";
        tri_layer {
            if-layers = <LAYER_SYM LAYER_NAV>;
            then-layer = <LAYER_RAT>;
        };
    };

    keymap {
        compatible = "zmk,keymap";

        abc_layer { // LAYER_ABC
            display-name = "abc";
            bindings = <
                // Row 1
                &as Q &as W &as F &as P &as B
                &as J &as L &as U &as Y &as MINUS
                // Row 2
                SHRML(A, R, S, T) &as G
                &as M SHRMR(N, E, I, O)
                // Row 3
                &as Z &as X &as C &as D &as V
                &as K &as H &as COMMA &as DOT &as RSQT
                // Row 4
                &alt_repeat &lt LAYER_SYM SPACE
                &lt LAYER_NAV BSPC &repeat
            >;
        };

        sym_layer { // LAYER_SYM
            display-name = "sym";
            bindings = <
                // Row 1
                &none &none &none &none &none
                &none &as SEMI &as LBKT &as RBKT &as BSLH
                // Row 2
                SHRML(N1, N2, N3, N4) &as N5
                &as N6 SHRMR(N7, N8, N9, N0)
                // Row 3
                &none &as MINUS &as EQUAL &as GRAVE &none
                &none &as SQT &as COMMA &as DOT &as FSLH
                // Row 4
                &trans &trans
                &trans &trans
            >;
        };

        nav_layer { // LAYER_NAV
            display-name = "nav";
            bindings = <
                // Row 1
                &none &none &none &none &none
                &none &none &none &none &none
                // Row 2
                &sk LSHFT &sk RALT &sk LCTRL &sk LGUI &none
                &kp LEFT &kp DOWN &kp UP &kp RIGHT &none
                // Row 3
                &kp LG(Z) &kp LG(X) &kp LG(C) &kp LG(V) &kp LG(LS(LA(V)))
                &kp PG_DN &kp END &kp HOME &kp PG_UP &none
                // Row 4
                &trans &trans
                &trans &trans
            >;
        };

        fun_layer { // LAYER_FUN
            display-name = "fun";
            bindings = <
                // Row 1
                &kp F1 &kp F2 &kp F3 &kp F4 &kp F5
                &kp F6 &kp F7 &kp F8 &kp F9 &kp F10
                // Row 2
                &kp LSHFT &kp LALT &kp LCTRL &kp LGUI &kp F11
                &kp F12 &hrmr RGUI C_VOL_DN &hrmr RCTRL C_MUTE &hrmr RALT C_VOL_UP &kp RSHFT
                // Row 3
                &none &none &none &none &none
                &none &kp C_PREV &kp C_PP &kp C_NEXT &none
                // Row 4
                &trans &trans
                &trans &trans
            >;
        };

        rat_layer { // LAYER_RAT
            display-name = "rat";
            bindings = <
                // Row 1
                &none &none &msc SCRL_DOWN &none &none
                &none &none &mmv MOVE_UP &none &none
                // Row 2
                &none &msc SCRL_RIGHT &msc SCRL_UP &msc SCRL_LEFT &none
                &none &mmv MOVE_LEFT &mmv MOVE_DOWN &mmv MOVE_RIGHT &none
                // Row 3
                &none &mkp RCLK &mkp MCLK &mkp LCLK &none
                &none &kp LGUI &kp LCTRL &kp LALT &kp LSHFT
                // Row 4
                &trans &trans
                &trans &trans
            >;
        };
    };

    combos {
        compatible = "zmk,combos";

        // Function layer
        combo_fun_layer {
            timeout-ms = <50>;
            key-positions = <30 33>;
            bindings = <&mo LAYER_FUN>;
            layers = <LAYER_ABC>;
        };

        // Bootloader
        MAKE_COMBO(combo_bootloader_left, 0 1 2 3, &bootloader, LAYER_FUN)

        // Sleep (no_cheese)
        MAKE_COMBO(combo_no_cheese, 0 1 2 3, &no_cheese, LAYER_ABC)

        // Screenshot
        MAKE_COMBO(combo_screenshot, 6 7 8 9, &screenshot, LAYER_ABC)

        // Spotlight
        MAKE_COMBO(combo_spotlight, 20 21 22 23, &kp LG(SPACE), LAYER_ABC)

        // Mute
        MAKE_COMBO(combo_mute, 26 27 28 29, &kp C_MUTE, LAYER_ABC)

        // Esc
        MAKE_COMBO(combo_esc, 1 2, &kp ESC, LAYER_ABC LAYER_SYM)

        // Del
        MAKE_COMBO(combo_del, 7 8, &kp DEL, LAYER_ABC LAYER_SYM)

        // Tab
        MAKE_COMBO(combo_tab, 11 12, &as TAB, LAYER_ABC LAYER_SYM)

        // Backspace
        MAKE_COMBO(combo_bspc, 17 18, &kp BSPC, LAYER_ABC LAYER_SYM)

        // Enter
        MAKE_COMBO(combo_enter, 27 28, &kp ENTER, LAYER_ABC LAYER_SYM)

        // Space
        MAKE_COMBO(combo_space_left,  21 22 23, &kp SPACE, LAYER_ABC LAYER_SYM)
        MAKE_COMBO(combo_space_right, 26 27 28, &kp SPACE, LAYER_ABC LAYER_SYM)

        // Caps word
        MAKE_COMBO(combo_cap, 21 22, &caps_word, LAYER_ABC LAYER_SYM)

        // Symbols
        MAKE_COMBO(combo_amper,     0 1,   &as AMPS,  LAYER_ABC LAYER_SYM)
        MAKE_COMBO(combo_colon,     2 3,   &as COLON, LAYER_ABC LAYER_SYM)
        MAKE_COMBO(combo_ldquote,   3 4,   &as LDQT,  LAYER_ABC LAYER_SYM)
        MAKE_COMBO(combo_star,      5 6,   &as STAR,  LAYER_ABC LAYER_SYM)
        MAKE_COMBO(combo_semi,      6 7,   &as SEMI,  LAYER_ABC LAYER_SYM)
        MAKE_COMBO(combo_pipe,      8 9,   &as PIPE,  LAYER_ABC LAYER_SYM)
        MAKE_COMBO(combo_percent,  10 11,  &as PRCNT, LAYER_ABC LAYER_SYM)
        MAKE_COMBO(combo_dquote,   12 13,  &as DQT,   LAYER_ABC LAYER_SYM)
        MAKE_COMBO(combo_grave,    13 14,  &as GRAVE, LAYER_ABC LAYER_SYM)
        MAKE_COMBO(combo_lbracket, 15 16,  &as LBKT,  LAYER_ABC LAYER_SYM)
        MAKE_COMBO(combo_lparen,   16 17,  &as LPAR,  LAYER_ABC LAYER_SYM)
        MAKE_COMBO(combo_less,     18 19,  &as LT,    LAYER_ABC LAYER_SYM)
        MAKE_COMBO(combo_dollar,   20 21,  &as DLLR,  LAYER_ABC LAYER_SYM)
        MAKE_COMBO(combo_equal,    22 23,  &as EQUAL, LAYER_ABC LAYER_SYM)
        MAKE_COMBO(combo_lsquote,  23 24,  &as LSQT,  LAYER_ABC LAYER_SYM)
        MAKE_COMBO(combo_slash,    25 26,  &as FSLH,  LAYER_ABC LAYER_SYM)
        MAKE_COMBO(combo_lbrace,   26 27,  &as LBRC,  LAYER_ABC LAYER_SYM)
        MAKE_COMBO(combo_hash,     28 29,  &as HASH,  LAYER_ABC LAYER_SYM)
    };
};
