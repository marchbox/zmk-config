## dts/bindings/behaviors/zmk,behavior-auto-shift.yaml
```yaml
description: Auto Shift with physical hold-tap timing and shared Shift overrides
compatible: "zmk,behavior-auto-shift"
include: one_param.yaml

properties:
  tapping-term-ms:
    type: int
    default: 175
  overrides-layer:
    type: int
    default: -1
    description: Highest active layer on key press where overrides apply (-1 for all layers)
  overrides:
    type: array
    required: true
    description: Pairs of unshifted and shifted encoded keycodes
```

## dts/bindings/behaviors/zmk,behavior-resolved-repeat.yaml
```yaml
description: Repeat the last resolved key and its effective modifiers
compatible: "zmk,behavior-resolved-repeat"
include: zero_param.yaml

properties:
  alternate:
    type: boolean
    description: Use the alternates table instead of repeating the original key
  alternates:
    type: array
    default: []
    description: |
      Directional source/alternate encoded keycode pairs, matched in list order.
      Source modifiers must be present; other modifiers are preserved.
      Left and right Shift are interchangeable when matching.
      Put modifier-specific entries before unmodified entries for the same key.
      Unmapped keys do nothing. Repeats do not replace the remembered original key.
```
